/dts-v1/;
/plugin/;

/ {
	fragment@0 {
		target-path = "/npu@fdab0000";

		__overlay__ {
			status = "disabled";
		};
	};

	fragment@1 {
		target-path = "/iommu@fdab9000";

		__overlay__ {
			status = "disabled";
		};
	};
};
